VERSION ""

NS_ :

BS_:

BU_: STM32_eval

BO_ 100 LED: 1 STM32_eval
 SG_ Interval : 0|8@1+ (3.53,100) [100|1000] "mS" Vector__XXX

BO_ 110 Signal_Fill: 1 STM32_eval
 SG_ Fill : 0|8@1+ (0.39,0) [0|100] "%" Vector__XXX

BO_ 2047 OUT_CAN_Diag: 2 STM32_eval
 SG_ PWM : 0|8@1+ (0.39,0) [0|100] "%" Vector__XXX
 SG_ LED_Interval : 8|8@1+ (3.53,100) [100|1000] "mS" Vector__XXX

CM_ BO_ 2047 "ID: 0x69420";
BA_DEF_  "BusType" STRING ;
BA_DEF_ BO_  "VFrameFormat" ENUM  "StandardCAN","ExtendedCAN","reserved","reserved","reserved","reserved","reserved","reserved","reserved","reserved","reserved","reserved","reserved","reserved","StandardCAN_FD","ExtendedCAN_FD";
BA_DEF_DEF_  "BusType" "";
BA_DEF_DEF_  "VFrameFormat" "StandardCAN";
BA_ "BusType" "CAN FD";
